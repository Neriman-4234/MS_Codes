# file: MS_LW_2.ioc
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Mcu.Family=STM32F4
Mcu.Name=STM32F407V(E-G)Tx
Mcu.Package=LQFP100
NVIC.PriorityGroup=NVIC_PRIORITYGROUP_0
ProjectManager.HeapSize=0x200
ProjectManager.StackSize=0x400
ProjectManager.TargetToolchain=TrueSTUDIO
RCC.48MHZClocksFreq_Value=48000000
RCC.AHBFreq_Value=168000000
RCC.APB1CLKDivider=RCC_HCLK_DIV4
RCC.APB1Freq_Value=42000000
RCC.APB1TimFreq_Value=84000000
RCC.APB2CLKDivider=RCC_HCLK_DIV2
RCC.APB2Freq_Value=84000000
RCC.APB2TimFreq_Value=168000000
RCC.CortexFreq_Value=168000000
RCC.HCLKFreq_Value=168000000
RCC.HSE_VALUE=8000000
RCC.HSI_VALUE=16000000
RCC.LSE_VALUE=32768
RCC.PLLM=8
RCC.PLLN=168
RCC.PLLQ=7
RCC.SYSCLKFreq_VALUE=168000000
RCC.SYSCLKSource=RCC_SYSCLKSOURCE_PLLCLK
RCC.VCOOutputFreq_Value=336000000
board=STM32F407G-DISC1

// file: Core/Src/main.c
/* USER CODE BEGIN Header */
/**
  ******************************************************************************
  * @file           : main.c
  * @brief          : Main program body
  ******************************************************************************
  * @attention
  *
  * <h2><center>&copy; Copyright (c) 2023 STMicroelectronics.
  * All rights reserved.</center></h2>
  *
  * This software component is licensed by ST under BSD 3-Clause license,
  * the "License"; You may not use this file except in compliance with the
  * License. You may obtain a copy of the License at:
  *                        opensource.org/licenses/BSD-3-Clause
  *
  ******************************************************************************
  */
/* USER CODE END Header */
#include "main.h"

void SystemClock_Config(void);

int main(void)
{

  /* MCU Configuration--------------------------------------------------------*/

  /* Reset of all peripherals, Initializes the Flash interface and the Systick. */
  HAL_Init();

  /* Configure the system clock */
  void SystemClock_Config(void);
  void GPIO_Init(void);

  /* Initialize all configured peripherals */
  /* USER CODE BEGIN 2 */
GPIO_Init();
  /* USER CODE END 2 */

  /* Infinite loop */
  /* USER CODE BEGIN WHILE */
  int seconds = 0;
  int count = 0;
  while (1)
  {
	    /*  // Lab 2.1
		  //Green and Blue High
		  GPIOD-> ODR |=0b1001000000000000;
		  HAL_Delay(1000);

		  //Green High, Blue Low
		  GPIOD-> ODR &= 0x00000000;
		  GPIOD-> ODR |= 0b0001000000000000;
		  HAL_Delay(1000);

		  //Blue High and Green Low
		  GPIOD-> ODR &= 0x00000000;
		  GPIOD-> ODR |= 0b1000000000000000;
		  HAL_Delay(1000);

		  //GPIOD-> ODR &= 0x00000000;
		  //HAL_Delay(1000);
*/
//////////////////////////////////////////////////////////////////
/*
	  // Lab 2.2
		  if (seconds % 2 == 0) {
			  GPIOD-> ODR |= 0b1000000000000000; //blue
		  }
		  if (seconds % 2 == 1) {
			  GPIOD-> ODR |= 0b1000000000000000; //blue
			  GPIOD-> ODR |= 0b0010000000000000; //orange
		  }

		  HAL_Delay(900);
		  GPIOD-> ODR &= 0x00000000;
		  HAL_Delay(100);

		  seconds++;
*/
/////////////////////////////////////////////////////////////////
	     // Lab 2.3
	  if(GPIOA-> IDR & 0x00000001){
		  while(GPIOA-> IDR & 0x00000001);
	  		  count++;
	  }
	  if (count % 2 == 0) {
		  GPIOD-> ODR &= 0x00000000;
	  }
	  if (count % 2 == 1) {
		  GPIOD-> ODR |= 0x00002000;
	  }

/////////////////////////////////////////////////////////////////
/*
	  // Lab 2.4
	  if(GPIOA-> IDR & 0x00000001){
	  		  count++;
	  }
	  GPIOD-> ODR |= 0b1000000000000000;
	  HAL_Delay(1000+(500*count));
	  GPIOD-> ODR &= 0x00000000;
	  HAL_Delay(1000+(500*count));
*/
////////////////////////////////////////////////////////////////

    /* USER CODE END WHILE */

  }
}

void SystemClock_Config(void)
{
  RCC_OscInitTypeDef RCC_OscInitStruct = {0};
  RCC_ClkInitTypeDef RCC_ClkInitStruct = {0};

  /** Configure the main internal regulator output voltage
  */
  __HAL_RCC_PWR_CLK_ENABLE();
  __HAL_PWR_VOLTAGESCALING_CONFIG(PWR_REGULATOR_VOLTAGE_SCALE1);
  /** Initializes the RCC Oscillators according to the specified parameters
  * in the RCC_OscInitTypeDef structure.
  */
  RCC_OscInitStruct.OscillatorType = RCC_OSCILLATORTYPE_HSI;
  RCC_OscInitStruct.HSIState = RCC_HSI_ON;
  RCC_OscInitStruct.HSICalibrationValue = RCC_HSICALIBRATION_DEFAULT;
  RCC_OscInitStruct.PLL.PLLState = RCC_PLL_ON;
  RCC_OscInitStruct.PLL.PLLSource = RCC_PLLSOURCE_HSI;
  RCC_OscInitStruct.PLL.PLLM = 8;
  RCC_OscInitStruct.PLL.PLLN = 168;
  RCC_OscInitStruct.PLL.PLLP = RCC_PLLP_DIV2;
  RCC_OscInitStruct.PLL.PLLQ = 7;
  if (HAL_RCC_OscConfig(&RCC_OscInitStruct) != HAL_OK)
  {
    Error_Handler();
  }
  /** Initializes the CPU, AHB and APB buses clocks
  */
  RCC_ClkInitStruct.ClockType = RCC_CLOCKTYPE_HCLK|RCC_CLOCKTYPE_SYSCLK
                              |RCC_CLOCKTYPE_PCLK1|RCC_CLOCKTYPE_PCLK2;
  RCC_ClkInitStruct.SYSCLKSource = RCC_SYSCLKSOURCE_PLLCLK;
  RCC_ClkInitStruct.AHBCLKDivider = RCC_SYSCLK_DIV1;
  RCC_ClkInitStruct.APB1CLKDivider = RCC_HCLK_DIV4;
  RCC_ClkInitStruct.APB2CLKDivider = RCC_HCLK_DIV2;

  if (HAL_RCC_ClockConfig(&RCC_ClkInitStruct, FLASH_LATENCY_5) != HAL_OK)
  {
    Error_Handler();
  }
}

/* USER CODE BEGIN 4 */
void GPIO_Init(void) {
	//	enable the clock of PortA and PortD
		RCC->AHB1ENR = 0x00000009;          //peripheral clock enable register

		GPIOD-> MODER = 0x55000000;			//12,13,14,15 pins digital output
		GPIOD-> OTYPER = 0x00000000;		//12,13,14,15 pins Push pull
		GPIOD-> OSPEEDR = 0xFF000000;		//12,13,14,15 pins 100MHz
		GPIOD-> PUPDR = 0x00000000;			//12,13,14,15 pins no pull

		GPIOD->ODR = 0x00000000;            // port output date register -- set bits 12-15 register to 0
		GPIOA->IDR = 0x00000001;            // – port input data register
}
/* USER CODE END 4 */

void Error_Handler(void)
{
  __disable_irq();
  while (1)
  {
  }
}

/************************ (C) COPYRIGHT STMicroelectronics *****END OF FILE****/
